/*
 * ============================================================================
 * MixOS Linker Script - linker.ld
 * Описывает расположение секций в памяти для x86_64
 * ============================================================================ */

/* Точка входа в исполняемый файл */
ENTRY(_start)

SECTIONS
{
    /* Ядро загружается по адресу 1MB (стандарт для Multiboot) */
    . = 1M;

    /* Multiboot заголовок должен быть в начале файла */
    .multiboot ALIGN(4K) : {
        *(.multiboot)
    }

    /* Код ядра (.text секция) */
    .text ALIGN(4K) : {
        *(.text)
        *(.text.*)
    }

    /* Read-only данные (константы, строки) */
    .rodata ALIGN(4K) : {
        *(.rodata)
        *(.rodata.*)
    }

    /* Инициализированные данные */
    .data ALIGN(4K) : {
        *(.data)
        *(.data.*)
    }

    /* Неинициализированные данные (BSS) */
    .bss ALIGN(4K) : {
        *(COMMON)
        *(.bss)
        *(.bss.*)
    }

    /* Экспортируем символы для использования в коде */
    __kernel_start = 1M;
    __kernel_end = .;
    __kernel_size = __kernel_end - __kernel_start;

    /* Отбрасываем ненужные секции */
    /DISCARD/ : {
        *(.comment)
        *(.note*)
        *(.eh_frame)
    }
}
